## sdkconfig.defaults
```kconfig
# ESP32-S3 配置
CONFIG_IDF_TARGET="esp32s3"

# Flash 配置
CONFIG_ESPTOOLPY_FLASHSIZE_8MB=y
CONFIG_ESPTOOLPY_FLASHMODE_DIO=y

# PSRAM 配置
CONFIG_SPIRAM=y
CONFIG_SPIRAM_MODE_OCT=y
CONFIG_SPIRAM_SPEED_80M=y

# 分区表
CONFIG_PARTITION_TABLE_CUSTOM=y
CONFIG_PARTITION_TABLE_CUSTOM_FILENAME="partitions.csv"

# USB 串口
CONFIG_ESP_CONSOLE_USB_SERIAL_JTAG=y

# 日志
CONFIG_LOG_DEFAULT_LEVEL_INFO=y

# JPEG 解码配置 - 使用软件解码器输出 RGB565
CONFIG_JD_USE_ROM=n
CONFIG_JD_FORMAT_RGB565=y
CONFIG_JD_SZBUF=4096
CONFIG_JD_FASTDECODE=1

# 唤醒词模型配置
CONFIG_MODEL_IN_FLASH=y
CONFIG_SR_WN_WN9_NIHAOXIAOAN_TTS2=y
```
